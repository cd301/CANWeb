VERSION ""

NS_ :

BS_:

BU_: Vector__XXX

BO_ 256 EngineData: 8 Vector__XXX
 SG_ EngineSpeed : 0|16@1+ (0.25,0) [0|16383.75] "rpm" Vector__XXX
 SG_ Throttle : 16|8@1+ (0.392156863,0) [0|100] "%" Vector__XXX

BO_ 512 VehicleData: 8 Vector__XXX
 SG_ VehicleSpeed : 0|16@1+ (0.01,0) [0|655.35] "km/h" Vector__XXX
 SG_ SteeringAngle : 16|16@1- (0.1,0) [-3276.8|3276.7] "deg" Vector__XXX

BO_ 768 EnvironmentData: 8 Vector__XXX
 SG_ CoolantTemp : 0|8@1- (1,-40) [-40|215] "C" Vector__XXX
 SG_ FuelLevel : 8|8@1+ (0.4,0) [0|100] "%" Vector__XXX

BO_ 1024 BatteryData: 8 Vector__XXX
 SG_ BatteryVoltage : 0|16@1+ (0.01,0) [0|655.35] "V" Vector__XXX
 SG_ BatteryCurrent : 16|16@1- (0.1,0) [-3276.8|3276.7] "A" Vector__XXX

BO_ 2566853172 TruckStatus: 8 Vector__XXX
 SG_ OilPressure : 0|16@1+ (0.1,0) [0|6553.5] "kPa" Vector__XXX
 SG_ BrakePressure : 16|16@1+ (0.1,0) [0|6553.5] "kPa" Vector__XXX

BO_ 2566869880 AxleData: 8 Vector__XXX
 SG_ AxleLoad : 0|16@1+ (1,0) [0|65535] "kg" Vector__XXX
 SG_ SuspensionHeight : 16|16@1+ (0.1,0) [0|6553.5] "mm" Vector__XXX
